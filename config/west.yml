## config/west.yml
```yaml
manifest:
  remotes:
    - name: zmkfirmware
      url-base: https://github.com/zmkfirmware
    - name: Deemen17
      url-base: https://github.com/Deemen17
  projects:
    # - name: zmk
    #   remote: zmkfirmware
    #   revision: main
    #   import: app/west.yml
    - name: zmk
      remote: Deemen17
      revision: de60
      import: app/west.yml
    - name: zmk-rgbled-widget
      remote: Deemen17
      revision: main
  self:
    path: config
```
